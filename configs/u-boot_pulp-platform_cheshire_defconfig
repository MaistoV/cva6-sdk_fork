## configs/u-boot_pulp-platform_cheshire_defconfig
```kconfig
CONFIG_RISCV=y
CONFIG_DEFAULT_DEVICE_TREE="pulp-platform_cheshire"
CONFIG_TARGET_PULP_PLATFORM_CHESHIRE=y
CONFIG_ARCH_RV64I=y
CONFIG_RISCV_SMODE=y
CONFIG_OF_LIBFDT=y
CONFIG_OF_BOARD_SETUP=y
CONFIG_OF_PRIOR_STAGE=y
CONFIG_BOOTDELAY=3
CONFIG_USE_BOOTCOMMAND=y
# CONFIG_BOOTCOMMAND="mmc info; mmc read 90000000 2000 5000; bootm 90000000 - $(fdtcontroladdr)"
CONFIG_DISPLAY_CPUINFO=y
# CONFIG_SPL_SPI_FLASH_MTD=y
CONFIG_CMD_GPT=y
# CONFIG_RANDOM_UUID is not set
CONFIG_CMD_MMC=y
CONFIG_CMD_MTD=y
CONFIG_CMD_PART=y
CONFIG_OF_EMBED=n
CONFIG_MMC=y
# CONFIG_MMC_WRITE is not set
CONFIG_MMC_SPI=y
CONFIG_DM_MTD=y
CONFIG_MTD_SPI_NAND=y
# Enable all available SPI drivers (?)
CONFIG_SPI_FLASH_ATMEL=y
CONFIG_SPI_FLASH_EON=y
CONFIG_SPI_FLASH_GIGADEVICE=y
CONFIG_SPI_FLASH_ISSI=y
CONFIG_SPI_FLASH_MACRONIX=y
CONFIG_SPI_FLASH_SPANSION=y
CONFIG_SPI_FLASH_STMICRO=y
CONFIG_SPI_FLASH_SST=y
CONFIG_SPI_FLASH_WINBOND=y
CONFIG_SPI_FLASH_XMC=y
# CONFIG_SPI_FLASH_USE_4K_SECTORS is not set
CONFIG_SPI_FLASH_MTD=y
CONFIG_SYS_NS16550=y
CONFIG_SPI=y
# CONFIG_OPENTITAN_QSPI=y
CONFIG_LOG=y
CONFIG_LOG_MAX_LEVEL=9
CONFIG_LOGF_FUNC=y
CONFIG_LOG_ERROR_RETURN=y
CONFIG_BOOTSTAGE_REPORT=y

## SPL related
# CONFIG_FIT=y
# CONFIG_SPL=y
# CONFIG_SPL_LOAD_FIT=y
# CONFIG_SYS_MALLOC_F_LEN=0x3000
# CONFIG_SPL_MTD_SUPPORT=y
# CONFIG_SPL_SPI_FLASH_MTD=y
# CONFIG_SPL_SPI_FLASH_SUPPORT=y
# CONFIG_SPL_SPI_SUPPORT=y
# CONFIG_SPL_SPI_LOAD=y
# CONFIG_SPL_DM=y
# CONFIG_SPL_DM_SPI=y
# CONFIG_SPL_DM_SPI_FLASH=y
# CONFIG_SPL_LIBCOMMON_SUPPORT=y
CONFIG_CMD_MTDPARTS=y
CONFIG_MTDIDS_DEFAULT="nor0=spi0.0"
CONFIG_MTDPARTS_DEFAULT="mtdparts=spi0.0:96m(bitstream),1m(u-boot),16m(uimage),-(filesystem)"

CONFIG_MTD=y
CONFIG_XILINX_SPI=y
CONFIG_BOOTCOMMAND="sf probe; sf read 82000000 6100000 b00000; bootm 82000000 - $(fdtcontroladdr);"

# From AlSaqr
CONFIG_CMD_FDT=y
```
